## sdkconfig.defaults.esp32s3
```kconfig
CONFIG_ESPTOOLPY_FLASHSIZE_32MB=y
CONFIG_ESPTOOLPY_FLASHMODE_QIO=y
CONFIG_ESPTOOLPY_FLASHFREQ_80M=y
CONFIG_IDF_EXPERIMENTAL_FEATURES=y
CONFIG_BOOTLOADER_CACHE_32BIT_ADDR_QUAD_FLASH=y

CONFIG_ESP_DEFAULT_CPU_FREQ_MHZ_240=y

CONFIG_ESP_TASK_WDT_PANIC=y
CONFIG_TASK_WDT_PANIC=y

CONFIG_SPIRAM=y
CONFIG_SPIRAM_MODE_OCT=y
CONFIG_SPIRAM_SPEED_80M=y
CONFIG_SPIRAM_MALLOC_ALWAYSINTERNAL=2048
CONFIG_SPIRAM_MALLOC_RESERVE_INTERNAL=98304
CONFIG_SPIRAM_MEMTEST=n
CONFIG_MBEDTLS_EXTERNAL_MEM_ALLOC=y

CONFIG_ESP_WIFI_STATIC_RX_BUFFER_NUM=3
CONFIG_ESP_WIFI_DYNAMIC_RX_BUFFER_NUM=6
CONFIG_ESP_WIFI_RX_BA_WIN=3
CONFIG_LWIP_TCPIP_RECVMBOX_SIZE=16
CONFIG_MBEDTLS_DYNAMIC_FREE_CONFIG_DATA=y

CONFIG_ESP32S3_INSTRUCTION_CACHE_32KB=y
CONFIG_ESP32S3_DATA_CACHE_LINE_64B=y

CONFIG_BOARD_TYPE_BAJI_ESP32_S3_TOUCH_LCD_1_85=y

CONFIG_SR_WN_WN9_NIHAOXIAOZHI_TTS=y

# 聆听(LISTENING)状态下仍运行唤醒词，便于打断对话；待机(IDLE)下本就开启
CONFIG_WAKE_WORD_DETECTION_IN_LISTENING=y

CONFIG_ESP_SYSTEM_EVENT_TASK_STACK_SIZE=4096

CONFIG_USB_HOST_CONTROL_TRANSFER_MAX_SIZE=1536

# LVGL Graphics
CONFIG_LV_USE_SNAPSHOT=y

# OTA (default; can be overridden by NVS Settings("wifi").ota_url)
CONFIG_OTA_URL="https://www.xinyhx.com/apicyhx/device/ota/"

# Reduce firmware size by lowering default log verbosity
CONFIG_LOG_DEFAULT_LEVEL_WARN=y

CONFIG_USE_CUSTOM_WAKE_WORD=y
CONFIG_CUSTOM_WAKE_WORD="ni hao ge ge"
CONFIG_CUSTOM_WAKE_WORD_DISPLAY="你好哥哥"
CONFIG_CUSTOM_WAKE_WORD_THRESHOLD=10
```
